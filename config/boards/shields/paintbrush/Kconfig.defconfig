## config/boards/shields/paintbrush/Kconfig.defconfig
```kconfig
if SHIELD_PAINTBRUSH_RIGHT

config ZMK_KEYBOARD_NAME
    default "Paintbrush"

config ZMK_SPLIT_ROLE_CENTRAL
    default y

endif

if SHIELD_PAINTBRUSH_LEFT || SHIELD_PAINTBRUSH_RIGHT

config ZMK_SPLIT
    default y

endif
```

## config/boards/shields/paintbrush/Kconfig.shield
```kconfig
# Copyright (c) 2021 Mike "KemoNine" Crosson
# SPDX-License-Identifier: MIT
config SHIELD_PAINTBRUSH_LEFT
    def_bool $(shields_list_contains,paintbrush_left)

config SHIELD_PAINTBRUSH_RIGHT
    def_bool $(shields_list_contains,paintbrush_right)
```
